const static Mapping keyMappings[16][40] PROGMEM = {
	{
		{ },
		{ },
		{ },
		{ },
		{ },
		{ },
		{ },
		{KEY_BACKSPACE, 0, 0, KEY_BACKSPACE, 0 },
		{ },
		{ },
		{KEY_Q, 0, 0, KEY_BACKSPACE, 0 },
		{KEY_W, 0, 0, KEY_BACKSPACE, 0 },
		{KEY_E, 0, 0, KEY_BACKSPACE, 0 },
		{KEY_R, 0, 0, KEY_BACKSPACE, 0 },
		{KEY_T, 0, 0, KEY_BACKSPACE, 0 },
		{KEY_Y, 0, 0, KEY_BACKSPACE, 0 },
		{KEY_U, 0, 0, KEY_BACKSPACE, 0 },
		{KEY_I, 0, 0, KEY_BACKSPACE, 0 },
		{KEY_O, 0, 0, KEY_BACKSPACE, 0 },
		{KEY_P, 0, 0, KEY_BACKSPACE, 0 },
		{KEY_A, 0, 0, KEY_BACKSPACE, 0 },
		{KEY_S, 0, 0, KEY_BACKSPACE, 0 },
		{KEY_D, 0, 0, KEY_BACKSPACE, 0 },
		{KEY_F, 0, 0, KEY_BACKSPACE, 0 },
		{KEY_G, 0, 0, KEY_BACKSPACE, 0 },
		{KEY_H, 0, 0, KEY_BACKSPACE, 0 },
		{KEY_J, 0, 0, KEY_BACKSPACE, 0 },
		{KEY_K, 0, 0, KEY_BACKSPACE, 0 },
		{KEY_L, 0, 0, KEY_BACKSPACE, 0 },
		{KEY_SEMICOLON, 0, 0, KEY_BACKSPACE, 0 },
		{KEY_Z, 0, 0, KEY_BACKSPACE, 0 },
		{KEY_X, 0, 0, KEY_BACKSPACE, 0 },
		{KEY_C, 0, 0, KEY_BACKSPACE, 0 },
		{KEY_V, 0, 0, KEY_BACKSPACE, 0 },
		{KEY_B, 0, 0, KEY_BACKSPACE, 0 },
		{KEY_N, 0, 0, KEY_BACKSPACE, 0 },
		{KEY_M, 0, 0, KEY_BACKSPACE, 0 },
		{ },
		{KEY_SPACE, 0, 0, KEY_BACKSPACE, 0 },
		{KEY_ENTER, 0, 0, KEY_BACKSPACE, 0 },
	},
	{
		{ },
		{ },
		{ },
		{ },
		{ },
		{ },
		{ },
		{KEY_BACKSPACE, 0, 0, KEY_BACKSPACE, 0 },
		{ },
		{ },
		{KEY_1, KEY_SHIFT, 0, KEY_BACKSPACE, 0 },
		{KEY_2, KEY_SHIFT, 0, KEY_BACKSPACE, 0 },
		{KEY_3, KEY_SHIFT, 0, KEY_BACKSPACE, 0 },
		{KEY_4, KEY_SHIFT, 0, KEY_BACKSPACE, 0 },
		{KEY_5, KEY_SHIFT, 0, KEY_BACKSPACE, 0 },
		{ },
		{KEY_MINUS, 0, 0, KEY_BACKSPACE, 0 },
		{KEY_EQUAL, 0, 0, KEY_BACKSPACE, 0 },
		{KEY_MINUS, KEY_SHIFT, 0, KEY_BACKSPACE, 0 },
		{KEY_EQUAL, KEY_SHIFT, 0, KEY_BACKSPACE, 0 },
		{KEY_6, KEY_SHIFT, 0, KEY_BACKSPACE, 0 },
		{KEY_7, KEY_SHIFT, 0, KEY_BACKSPACE, 0 },
		{KEY_8, KEY_SHIFT, 0, KEY_BACKSPACE, 0 },
		{KEY_9, KEY_SHIFT, 0, KEY_BACKSPACE, 0 },
		{KEY_0, KEY_SHIFT, 0, KEY_BACKSPACE, 0 },
		{ },
		{KEY_LEFT_BRACE, 0, 0, KEY_BACKSPACE, 0 },
		{KEY_RIGHT_BRACE, 0, 0, KEY_BACKSPACE, 0 },
		{KEY_LEFT_BRACE, 0, 0, KEY_BACKSPACE, 0 },
		{KEY_RIGHT_BRACE, 0, 0, KEY_BACKSPACE, 0 },
		{KEY_SLASH, 0, 0, KEY_BACKSPACE, 0 },
		{KEY_BACKSLASH, 0, 0, KEY_BACKSPACE, 0 },
		{KEY_SLASH, KEY_SHIFT, 0, KEY_BACKSPACE, 0 },
		{KEY_BACKSLASH, KEY_SHIFT, 0, KEY_BACKSPACE, 0 },
		{ },
		{ },
		{KEY_COMMA, 0, 0, KEY_BACKSPACE, 0 },
		{KEY_PERIOD, 0, 0, KEY_BACKSPACE, 0 },
		{KEY_COMMA, KEY_SHIFT, 0, KEY_BACKSPACE, 0 },
		{KEY_PERIOD, KEY_SHIFT, 0, KEY_BACKSPACE, 0 },
	},
	{
		{ },
		{ },
		{ },
		{ },
		{ },
		{ },
		{ },
		{KEY_BACKSPACE, 0, 0, KEY_BACKSPACE, 0 },
		{ },
		{ },
		{ },
		{ },
		{ },
		{ },
		{ },
		{ },
		{KEY_7, 0, 0, KEY_BACKSPACE, 0 },
		{KEY_8, 0, 0, KEY_BACKSPACE, 0 },
		{KEY_9, 0, 0, KEY_BACKSPACE, 0 },
		{ },
		{ },
		{ },
		{ },
		{ },
		{ },
		{KEY_PERIOD, 0, 0, KEY_BACKSPACE, 0 },
		{KEY_4, 0, 0, KEY_BACKSPACE, 0 },
		{KEY_5, 0, 0, KEY_BACKSPACE, 0 },
		{KEY_6, 0, 0, KEY_BACKSPACE, 0 },
		{ },
		{ },
		{ },
		{ },
		{ },
		{ },
		{KEY_0, 0, 0, KEY_BACKSPACE, 0 },
		{KEY_1, 0, 0, KEY_BACKSPACE, 0 },
		{KEY_2, 0, 0, KEY_BACKSPACE, 0 },
		{KEY_3, 0, 0, KEY_BACKSPACE, 0 },
		{ },
	},
	{
		{ },
		{ },
		{ },
		{ },
		{ },
		{ },
		{ },
		{ },
		{ },
		{ },
		{ },
		{ },
		{ },
		{ },
		{ },
		{ },
		{ },
		{ },
		{ },
		{ },
		{ },
		{ },
		{ },
		{ },
		{ },
		{ },
		{ },
		{ },
		{ },
		{ },
		{ },
		{ },
		{ },
		{ },
		{ },
		{ },
		{ },
		{ },
		{ },
		{ },
	},
	{
		{ },
		{ },
		{ },
		{ },
		{ },
		{ },
		{ },
		{ },
		{ },
		{ },
		{KEY_Q, KEY_SHIFT, 0, KEY_BACKSPACE, 0 },
		{KEY_W, KEY_SHIFT, 0, KEY_BACKSPACE, 0 },
		{KEY_E, KEY_SHIFT, 0, KEY_BACKSPACE, 0 },
		{KEY_R, KEY_SHIFT, 0, KEY_BACKSPACE, 0 },
		{KEY_T, KEY_SHIFT, 0, KEY_BACKSPACE, 0 },
		{KEY_Y, KEY_SHIFT, 0, KEY_BACKSPACE, 0 },
		{KEY_U, KEY_SHIFT, 0, KEY_BACKSPACE, 0 },
		{KEY_I, KEY_SHIFT, 0, KEY_BACKSPACE, 0 },
		{KEY_O, KEY_SHIFT, 0, KEY_BACKSPACE, 0 },
		{KEY_P, KEY_SHIFT, 0, KEY_BACKSPACE, 0 },
		{KEY_A, KEY_SHIFT, 0, KEY_BACKSPACE, 0 },
		{KEY_S, KEY_SHIFT, 0, KEY_BACKSPACE, 0 },
		{KEY_D, KEY_SHIFT, 0, KEY_BACKSPACE, 0 },
		{KEY_F, KEY_SHIFT, 0, KEY_BACKSPACE, 0 },
		{KEY_G, KEY_SHIFT, 0, KEY_BACKSPACE, 0 },
		{KEY_H, KEY_SHIFT, 0, KEY_BACKSPACE, 0 },
		{KEY_J, KEY_SHIFT, 0, KEY_BACKSPACE, 0 },
		{KEY_K, KEY_SHIFT, 0, KEY_BACKSPACE, 0 },
		{KEY_L, KEY_SHIFT, 0, KEY_BACKSPACE, 0 },
		{ },
		{KEY_Z, KEY_SHIFT, 0, KEY_BACKSPACE, 0 },
		{KEY_X, KEY_SHIFT, 0, KEY_BACKSPACE, 0 },
		{KEY_C, KEY_SHIFT, 0, KEY_BACKSPACE, 0 },
		{KEY_V, KEY_SHIFT, 0, KEY_BACKSPACE, 0 },
		{KEY_B, KEY_SHIFT, 0, KEY_BACKSPACE, 0 },
		{KEY_N, KEY_SHIFT, 0, KEY_BACKSPACE, 0 },
		{KEY_M, KEY_SHIFT, 0, KEY_BACKSPACE, 0 },
		{ },
		{ },
		{ },
	},
	{
		{ },
		{ },
		{ },
		{ },
		{ },
		{ },
		{ },
		{ },
		{ },
		{ },
		{KEY_Q, KEY_CTRL, 0, KEY_BACKSPACE, 0 },
		{ },
		{ },
		{ },
		{ },
		{ },
		{ },
		{ },
		{ },
		{ },
		{ },
		{KEY_S, KEY_CTRL, 0, KEY_BACKSPACE, 0 },
		{ },
		{KEY_F, KEY_CTRL, 0, KEY_BACKSPACE, 0 },
		{ },
		{ },
		{ },
		{ },
		{ },
		{ },
		{KEY_Z, KEY_CTRL, 0, KEY_BACKSPACE, 0 },
		{KEY_X, KEY_CTRL, 0, KEY_BACKSPACE, 0 },
		{KEY_C, KEY_CTRL, 0, KEY_BACKSPACE, 0 },
		{KEY_V, KEY_CTRL, 0, KEY_BACKSPACE, 0 },
		{ },
		{ },
		{ },
		{ },
		{ },
		{ },
	},
	{
		{ },
		{ },
		{ },
		{ },
		{ },
		{ },
		{ },
		{ },
		{ },
		{ },
		{ },
		{ },
		{ },
		{ },
		{ },
		{ },
		{ },
		{ },
		{ },
		{ },
		{ },
		{ },
		{ },
		{ },
		{ },
		{ },
		{ },
		{ },
		{ },
		{ },
		{ },
		{ },
		{ },
		{ },
		{ },
		{ },
		{ },
		{ },
		{ },
		{ },
	},
	{
		{ },
		{ },
		{ },
		{ },
		{ },
		{ },
		{ },
		{ },
		{ },
		{ },
		{ },
		{ },
		{ },
		{ },
		{ },
		{ },
		{ },
		{ },
		{ },
		{ },
		{ },
		{ },
		{ },
		{ },
		{ },
		{ },
		{ },
		{ },
		{ },
		{ },
		{ },
		{ },
		{ },
		{ },
		{ },
		{ },
		{ },
		{ },
		{ },
		{ },
	},
	{
		{ },
		{ },
		{ },
		{ },
		{ },
		{ },
		{ },
		{ },
		{ },
		{ },
		{ },
		{ },
		{ },
		{ },
		{ },
		{ },
		{KEY_HOME, 0, 0, KEY_BACKSPACE, 0 },
		{KEY_UP, 0, 0, KEY_BACKSPACE, 0 },
		{KEY_PAGE_UP, 0, 0, KEY_BACKSPACE, 0 },
		{ },
		{KEY_SHIFT, 0, 0, KEY_BACKSPACE, 0 },
		{KEY_CTRL, 0, 0, KEY_BACKSPACE, 0 },
		{KEY_ALT, 0, 0, KEY_BACKSPACE, 0 },
		{ },
		{ },
		{ },
		{KEY_LEFT, 0, 0, KEY_BACKSPACE, 0 },
		{KEY_DOWN, 0, 0, KEY_BACKSPACE, 0 },
		{KEY_RIGHT, 0, 0, KEY_BACKSPACE, 0 },
		{ },
		{ },
		{ },
		{ },
		{ },
		{ },
		{ },
		{KEY_END, 0, 0, KEY_BACKSPACE, 0 },
		{ },
		{KEY_PAGE_DOWN, 0, 0, KEY_BACKSPACE, 0 },
		{ },
	},
	{
		{ },
		{ },
		{ },
		{ },
		{ },
		{ },
		{ },
		{ },
		{ },
		{ },
		{ },
		{ },
		{ },
		{ },
		{ },
		{ },
		{ },
		{ },
		{ },
		{ },
		{ },
		{ },
		{ },
		{ },
		{ },
		{ },
		{ },
		{ },
		{ },
		{ },
		{ },
		{ },
		{ },
		{ },
		{ },
		{ },
		{ },
		{ },
		{ },
		{ },
	},
	{
		{ },
		{ },
		{ },
		{ },
		{ },
		{ },
		{ },
		{ },
		{ },
		{ },
		{ },
		{ },
		{ },
		{ },
		{ },
		{ },
		{ },
		{ },
		{ },
		{ },
		{ },
		{ },
		{ },
		{ },
		{ },
		{ },
		{ },
		{ },
		{ },
		{ },
		{ },
		{ },
		{ },
		{ },
		{ },
		{ },
		{ },
		{ },
		{ },
		{ },
	},
	{
		{ },
		{ },
		{ },
		{ },
		{ },
		{ },
		{ },
		{ },
		{ },
		{ },
		{ },
		{ },
		{ },
		{ },
		{ },
		{ },
		{ },
		{ },
		{ },
		{ },
		{ },
		{ },
		{ },
		{ },
		{ },
		{ },
		{ },
		{ },
		{ },
		{ },
		{ },
		{ },
		{ },
		{ },
		{ },
		{ },
		{ },
		{ },
		{ },
		{ },
	},
	{
		{ },
		{ },
		{ },
		{ },
		{ },
		{ },
		{ },
		{ },
		{ },
		{ },
		{ },
		{ },
		{ },
		{ },
		{ },
		{ },
		{ },
		{ },
		{ },
		{ },
		{ },
		{ },
		{ },
		{ },
		{ },
		{ },
		{ },
		{ },
		{ },
		{ },
		{ },
		{ },
		{ },
		{ },
		{ },
		{ },
		{ },
		{ },
		{ },
		{ },
	},
	{
		{ },
		{ },
		{ },
		{ },
		{ },
		{ },
		{ },
		{ },
		{ },
		{ },
		{ },
		{ },
		{ },
		{ },
		{ },
		{ },
		{ },
		{ },
		{ },
		{ },
		{ },
		{ },
		{ },
		{ },
		{ },
		{ },
		{ },
		{ },
		{ },
		{ },
		{ },
		{ },
		{ },
		{ },
		{ },
		{ },
		{ },
		{ },
		{ },
		{ },
	},
	{
		{ },
		{ },
		{ },
		{ },
		{ },
		{ },
		{ },
		{ },
		{ },
		{ },
		{ },
		{ },
		{ },
		{ },
		{ },
		{ },
		{ },
		{ },
		{ },
		{ },
		{ },
		{ },
		{ },
		{ },
		{ },
		{ },
		{ },
		{ },
		{ },
		{ },
		{ },
		{ },
		{ },
		{ },
		{ },
		{ },
		{ },
		{ },
		{ },
		{ },
	},
	{
		{ },
		{ },
		{ },
		{ },
		{ },
		{ },
		{ },
		{ },
		{ },
		{ },
		{ },
		{ },
		{ },
		{ },
		{ },
		{ },
		{ },
		{ },
		{ },
		{ },
		{ },
		{ },
		{ },
		{ },
		{ },
		{ },
		{ },
		{ },
		{ },
		{ },
		{ },
		{ },
		{ },
		{ },
		{ },
		{ },
		{ },
		{ },
		{ },
		{ },
	},
};
